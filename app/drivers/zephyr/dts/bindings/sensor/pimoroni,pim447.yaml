## app/drivers/zephyr/dts/bindings/sensor/pimoroni,pim447.yaml
```yaml
# Copyright (c) 2020, Peter Johanson
# SPDX-License-Identifier: Apache-2.0

description: Pimoroni PIM447 trackball breakout w/ RGB LEDs

compatible: "pimoroni,pim447"

include: i2c-device.yaml

properties:
    alert-gpios:
      type: phandle-array
      required: false
      description: >
        ALERT pin.
        This pin signals active low when produced by the sensor.  The
        property value should ensure the flags properly describe the
        signal that is presented to the driver.
```

## app/dts/bindings/behaviors/zmk,behavior-sensor-trackball-key-press.yaml
```yaml
# Copyright (c) 2020 The ZMK Contributors
# SPDX-License-Identifier: MIT

description: Sensor trackball key press/release behavior

compatible: "zmk,behavior-sensor-trackball-key-press"

properties:
  label:
    type: string
    required: true
  scan-interval-ms:
    type: int
  orientation:
    type: string
    required: false
    default: "south"
    enum:
      - "east"
      - "north"
      - "south"
      - "west"
  "#sensor-binding-cells":
    type: int
    required: true
    const: 2

sensor-binding-cells:
  - param1
  - param2
```
